## meta-ircona/conf/layer.conf
```bitbake
# We have a conf and classes directory, add to BBPATH
BBPATH .= ":${LAYERDIR}"

BBFILE_COLLECTIONS += "ircona"
BBFILE_PATTERN_ircona = ""

# Provide a variable that points the base of the Ircona layer.
IRCONABASE = '${@os.path.normpath("${LAYERDIR}/")}'
```

## meta-ircona/meta-ircona-aspeed/meta-ircona-ethanol/conf/layer.conf
```bitbake
# We have a conf and classes directory, add to BBPATH
BBPATH .= ":${LAYERDIR}"

# We have recipes-* directories, add to BBFILES
BBFILES += "${LAYERDIR}/recipes-*/*/*.bb \
            ${LAYERDIR}/recipes-*/*/*.bbappend"
BBFILE_COLLECTIONS += "ircona-ethanol"
BBFILE_PATTERN_ircona-ethanol = ""
```

## meta-ircona/meta-ircona-aspeed/meta-ircona-ethanol/conf/machine/ircona-ethanol.conf
```bitbake
KMACHINE = "aspeed"
KERNEL_DEVICETREE = "${KMACHINE}-ast2500-evb.dtb"

UBOOT_MACHINE = "ast_g5_phy_config"

FLASH_SIZE = "32768"

require conf/machine/include/ast2500.inc
require conf/machine/include/obmc-bsp-common.inc

OBMC_MACHINE_FEATURES += "\
        obmc-phosphor-fan-mgmt \
        obmc-phosphor-chassis-mgmt \
        obmc-phosphor-flash-mgmt \
        obmc-host-ipmi \
        obmc-host-state-mgmt \
        obmc-chassis-state-mgmt \
        obmc-bmc-state-mgmt \
        "

VIRTUAL-RUNTIME_skeleton_workbook = "${MACHINE}-config"

PREFERRED_PROVIDER_virtual/obmc-inventory-data ?= "${VIRTUAL-RUNTIME_skeleton_workbook}"
PREFERRED_PROVIDER_virtual/obmc-system-mgmt = "packagegroup-ircona-apps"
PREFERRED_PROVIDER_virtual/obmc-chassis-mgmt = "packagegroup-ircona-apps"
PREFERRED_PROVIDER_virtual/obmc-fan-mgmt = "packagegroup-ircona-apps"
PREFERRED_PROVIDER_virtual/obmc-flash-mgmt = "packagegroup-ircona-apps"
PREFERRED_PROVIDER_virtual/obmc-host-ipmi-hw = "phosphor-ipmi-kcs"
PREFERRED_PROVIDER_virtual/phosphor-led-manager-config-native = "ircona-led-manager-config-native"
PREFERRED_PROVIDER_virtual/phosphor-ipmi-sensor-inventory = "ircona-ipmi-sensor-inventory-native"
PREFERRED_PROVIDER_virtual/phosphor-ipmi-inventory-sel = "ircona-ipmi-inventory-sel-native"
```
